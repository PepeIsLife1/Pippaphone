## Pippaphone_firmware/componenti/scheda/Kconfig
```kconfig
menu "Pippaphone: scheda"

    choice SCHEDA
        prompt "Hardware del telefono"
        default SCHEDA_PIPPAPHONE
        help
            Su quale hardware gira il firmware. Il ripetitore funziona solo con la PCB
            Pippaphone (o con la scheda E22, che si sceglie nel suo menu).

        config SCHEDA_PIPPAPHONE
            bool "PCB Pippaphone rev. 1.1"
        config SCHEDA_TDECK_PLUS
            bool "LilyGO T-Deck Plus (ESP32-S3, 320x240, LoRa 868 MHz)"
    endchoice

endmenu
```

## Pippaphone_firmware/ripetitore/main/Kconfig.projbuild
```kconfig
menu "Pippaphone ripetitore"

    choice RIPETITORE_SCHEDA
        prompt "Scheda"
        default RIPETITORE_SCHEDA_TELEFONO
        help
            Su quale hardware gira il ripetitore.

        config RIPETITORE_SCHEDA_TELEFONO
            bool "PCB del telefono Pippaphone (per provare la rete)"
        config RIPETITORE_SCHEDA_E22
            bool "Scheda ripetitore: ESP32-S3 + Ebyte E22-900M30S (vedi HARDWARE.md)"
        config RIPETITORE_SCHEDA_HELTEC_V3
            bool "Heltec WiFi LoRa 32 V3 (in casa, sempre alimentato)"
            help
                ESP32-S3 + SX1262 + OLED 128x64. La USB-C e' collegata a un CP2102: si
                compila con sdkconfig.defaults.heltec, che mette la console sulla UART0.
        config RIPETITORE_SCHEDA_T3S3
            bool "LilyGO T3-S3 V1.2 con SX1262 (all'aperto, pannello solare)"
            help
                ESP32-S3 + SX1262 + OLED 128x64, tensione della batteria su GPIO1. Con la
                batteria quasi scarica si mette a dormire finche' il pannello non l'ha
                ricaricata. Si compila con sdkconfig.defaults.t3s3.
    endchoice

    config RIPETITORE_POTENZA_MAX
        int "Potenza massima dell'SX1262 (dBm)"
        range -9 22
        default 22
        help
            Con il modulo E22-900M30S l'SX1262 pilota un amplificatore da 1 W: a 22 dBm
            in ingresso il modulo esce a circa 30 dBm.

    config RIPETITORE_SCHERMO_SECONDI
        int "Schermo: secondi acceso dopo l'avvio o il tasto (0 = sempre acceso)"
        depends on RIPETITORE_SCHEDA_HELTEC_V3 || RIPETITORE_SCHEDA_T3S3
        range 0 3600
        default 60
        help
            Si cambia anche dalla console (schermo <secondi>). Un OLED sempre acceso si
            consuma e la scritta resta impressa: meglio lasciarlo spegnere.

    config RIPETITORE_BATTERIA_MIN_MV
        int "Batteria: sotto questa tensione (mV) il ripetitore va a dormire"
        depends on RIPETITORE_SCHEDA_T3S3
        range 3000 3800
        default 3300

    config RIPETITORE_BATTERIA_RIPARTE_MV
        int "Batteria: dopo il sonno riparte solo sopra questa tensione (mV)"
        depends on RIPETITORE_SCHEDA_T3S3
        range 3200 4100
        default 3600

    config RIPETITORE_SONNO_MINUTI
        int "Batteria scarica: ogni quanti minuti si sveglia a controllarla"
        depends on RIPETITORE_SCHEDA_T3S3
        range 1 240
        default 15

endmenu
```
